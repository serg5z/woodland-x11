## tests/idf_socket_capacity_poc/sdkconfig.defaults
```kconfig
CONFIG_IDF_TARGET="esp32s3"
CONFIG_LWIP_MAX_SOCKETS=72
CONFIG_LWIP_MAX_ACTIVE_TCP=72
CONFIG_LWIP_MAX_LISTENING_TCP=4
CONFIG_FREERTOS_HZ=1000
```
